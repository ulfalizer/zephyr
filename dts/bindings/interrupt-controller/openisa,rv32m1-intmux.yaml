## dts/bindings/interrupt-controller/openisa,rv32m1-intmux.yaml
```yaml
#
# Copyright (c) 2018 Foundries.io
#
# SPDX-License-Identifier: Apache-2.0
#

title: RV32M1 INTMUX
version: 0.1

description: >
    This binding describes the RV32M1 INTMUX IP

inherits:
    !include base.yaml

properties:
  compatible:
      constraint: "openisa,rv32m1-intmux"

  reg:
      category: required

  label:
      category: required

  interrupts:
      # The interrupt multiplexer is currently specified in a common device
      # tree file, but might not attached to anything for a particular board.
      # See commit 948ef47cf4 ("dts: riscv32: Add rv32m1 zero-riscy core
      # support"), where the .dtsi files specify 'interrupt' for either intmux0
      # or intmux1.
      category: optional

"#cells":
  - irq
```

## scripts/dts/bindings/controller-1-cell.yaml
```yaml
title: Interrupt controller with one cell
version: 1

description:

properties:
    compatible:
        constraint: "controller,one-cell"
        type: string-array
        generation: define

"#cells":
  - one
```

## scripts/dts/bindings/controller-2-cell.yaml
```yaml
title: Interrupt controller with two cells
version: 1

description:

properties:
    compatible:
        constraint: "controller,two-cell"
        type: string-array
        generation: define

"#cells":
  - one
  - two
```

## scripts/dts/bindings/controller-3-cell.yaml
```yaml
title: Interrupt controller with three cells
version: 1

description:

properties:
    compatible:
        constraint: "controller,three-cell"
        type: string-array
        generation: define

"#cells":
  - one
  - two
  - three
```

## scripts/dts/bindings/gpio-1-cell.yaml
```yaml
title: GPIO controller with one cell
version: 1

description:

properties:
    compatible:
        constraint: "gpio,one-cell"
        type: string-array

"#cells":
  - one
```

## scripts/dts/bindings/gpio-2-cell.yaml
```yaml
title: GPIO controller with two cells
version: 1

description:

properties:
    compatible:
        constraint: "gpio,two-cell"
        type: string-array
        generation: define

"#cells":
  - one
  - two
```

## scripts/dts/bindings/interrupt-1-cell.yaml
```yaml
title: Interrupt controller with one cell
version: 1

description:

properties:
    compatible:
        constraint: "interrupt,one-cell"
        type: string-array
        generation: define

"#cells":
  - one
```
